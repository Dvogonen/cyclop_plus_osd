/*******************************************************************************
  CYCLOP++ with OSD brings manual channel selection and onscreen information to
  the HobbyKing Quanum Cyclops FPV googles.

  The rx5808-pro and rx5808-pro-diversity projects served as a starting
  point for the code base, even if little of the actual code remains.
  Without those projects CYCLOP++ would not have been created. All possible
  credit goes to the two mentioned projects and their contributors.

  The max7456 library by theboredengineers with changes by Dvogonen is used
  to control the video circuit.

  Author: Kjell Kernen

  Copyright (c) 2017 Kjell Kernen (Dvogonen)

  Permission is hereby granted, free of charge, to any person obtaining a copy
  of this software and associated documentation files (the "Software"), to deal
  in the Software without restriction, including without limitation the rights
  to use, copy, modify, merge, publish, distribute, sublicense, and/or sell
  copies of the Software, and to permit persons to whom the Software is
  furnished to do so, subject to the following conditions:

  The above copyright notice and this permission notice shall be included in all
  copies or substantial portions of the Software.

  THE SOFTWARE IS PROVIDED "AS IS", WITHOUT WARRANTY OF ANY KIND, EXPRESS OR
  IMPLIED, INCLUDING BUT NOT LIMITED TO THE WARRANTIES OF MERCHANTABILITY,
  FITNESS FOR A PARTICULAR PURPOSE AND NONINFRINGEMENT. IN NO EVENT SHALL THE
  AUTHORS OR COPYRIGHT HOLDERS BE LIABLE FOR ANY CLAIM, DAMAGES OR OTHER
  LIABILITY, WHETHER IN AN ACTION OF CONTRACT, TORT OR OTHERWISE, ARISING FROM,
  OUT OF OR IN CONNECTION WITH THE SOFTWARE OR THE USE OR OTHER DEALINGS IN THE
  SOFTWARE.
 *******************************************************************************
   Character bitmaps stored in program memory. Needs more memory than in RAM
   0xFF is stored as 0x55 since program memory canmot hold series of 0xFF
 *******************************************************************************/
const char tableOfAllCharacters[13824] PROGMEM = {
  0x55, 0x55, 0x55, 0x55, 0x55, 0x55, 0x55, 0x55,
  0x55, 0x55, 0x55, 0x55, 0x55, 0x55, 0x55, 0x55,
  0x55, 0x55, 0x55, 0x55, 0x55, 0x55, 0x55, 0x55,
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  0x00, 0x00, 0x00, 0x00, 0x00, 0x00, 0x00, 0x00
};

/*******************************************************************************
   Includes
 *******************************************************************************/
#include "max7456.h"
#include <SPI.h>
#include <EEPROM.h>

/*******************************************************************************
  Minimosd Display Protocol Definition v1.0
   Formal definition for the display protocol: (Token[Command[Param]])*
   Tokens,  commands and params are all bytes.
   All tokens except 0 results in the corresponding character in the Max7456
   charmap being displayed onscreen  att current position using current params.
   The token 255 signals that the next byte is a command.
   Some commands have a single param.
   Some commands result in a single byte answer.
   Invalid characters are ignored (e.g. unknown commands, params that are out of
   bounds, etc).
 *******************************************************************************
  Protocol Commands:
 *******************************************************************************/
#define CMD_CMD             255 /* The start command token.                    */
#define CMD_LOAD_CHARS      1   /* Load charset to EEPROM. Needed only once    */
#define CMD_CLEAR_SCREEN    2   /* Empties the screen                          */
#define CMD_ENABLE_OSD      3   /* Shows OSD on video out                      */
#define CMD_DISABLE_OSD     4   /* Hides OSD on video out                      */
#define CMD_ENABLE_VIDEO    5   /* Shows video in on video out                 */
#define CMD_DISABLE_VIDEO   6   /* Hides video in from video out               */
#define CMD_ENABLE_BLINK    7   /* All upcomming characters will blink         */
#define CMD_DISABLE_BLINK   8   /* All upcoming characters will be stable      */
#define CMD_ENABLE_INVERSE  9   /* All upcoming characters are inversed        */
#define CMD_DISABLE_INVERSE 10  /* All upcoming characters without inverse     */
#define CMD_ENABLE_FILL     11  /* Fill background of upcoming characters      */
#define CMD_DISABLE_FILL    12  /* No background fill for upcoming characters  */
#define CMD_NEWLINE         13  /* Moves cursor to start of the next line      */
#define CMD_SET_X           14  /* Position X cursor (next char is a parameter)*/
#define CMD_SET_Y           15  /* Position Y cursor (next char is a parameter)*/
#define CMD_SET_OFFSET      16  /* Display Offset XY cursor (next 2 chars are parameters)*/

/*******************************************************************************
   Hardware Defines
 *******************************************************************************/
#define CS_PIN      6   // SPI Chip Select pin connected to Max7456
#define MAX_LINES   13  // For both NTSC and PAL
#define VIDEO_NONE  2   // No video format
#define VIDEO_PAL   1   // PAL video format
#define VIDEO_NTSC  0   // NTSC video format

/*******************************************************************************
   EEPROM addresses
 *******************************************************************************/
#define EEPROM_CHARSET_LOADED 0

/*******************************************************************************
   max7456 state variables. It is OK to use state values , but do not set them
   directly. Use the set functions for manipulating the states.
 *******************************************************************************/
bool blinkState = false;
bool inverseState = false;
bool fillState = false;
bool osdState = true;
bool inVideoState = true;

uint8_t curX = 0;        // May be directly manipulated
uint8_t curY = 0;        // May be directly manipulated
/*******************************************************************************
   Other Global Variables
 *******************************************************************************/
Max7456 osd;

/*******************************************************************************
   Function: setBlinkState
           : enables or disables blink of new characters written to screen.
           : the setting does not impact text already on screen
 *******************************************************************************/
void setBlinkState( bool newState )
{
  if ( newState != blinkState) {
    blinkState = newState;
  }
}

/*******************************************************************************
   Function: setOSDState
           : turns OSD information on and off
 *******************************************************************************/
void setOsdState( bool newState )
{
  if ( newState != osdState) {
    osdState = newState;
    osd.activateOSD( osdState );
  }
}

/*******************************************************************************
   Function: setFillState
           : enables or disables use of filled characters. Only affects new
           : characters written to screen. the setting does not impact text
           : already on screen.
           : Please note that only the "normal" writable characters (32-128)
           : will be filled. the setting has no effect on other character values.
 *******************************************************************************/
void setFillState( bool newState )
{
  if ( newState != fillState) {
    fillState = newState;
  }
}

/*******************************************************************************
   Function: setInverseCharState
           : enables or disables inverse of new characters written to screen.
           : White pixels become black and vice versa.
           : Transparent pixels stay transparent.
           : the setting does not impact text already on screen
 *******************************************************************************/
void setInverseState( bool newState )
{
  if ( newState != inverseState) {
    inverseState = newState;
  }
}

/*******************************************************************************
   Function: setInVideoState
           : TODO Check what this does. The data sheet and the library documentation
           : are not agreeing
 *******************************************************************************/
void setInVideoState( bool newState )
{
  if ( newState != inVideoState) {
    inVideoState = newState;
    osd.activateExternalVideo( inVideoState );
  }
}

/*******************************************************************************
   Function: updateVideoFormat
           : checks the incomming video format.
           : switches OSD video format if it differs from invideo format
           : if neither PAL or NTSC is detected, the OSD video format remains
           : unchanged.
 *******************************************************************************/
void updateVideoFormat( void )
{
  byte videoFormat = osd.getInVideoFormat();
  if (( videoFormat == VIDEO_PAL ) || ( videoFormat == VIDEO_NTSC ))
    osd.setOutVideoFormat( videoFormat );
}

/*******************************************************************************
   Function: newLine
           : moves cursor to first position on next line
 *******************************************************************************/
void newLine( void ) {
  curX = 0;
  curY++;
  if ( curY >= MAX_LINES )
    curY = 0;
}

/*******************************************************************************
   Function: loadCharSet
           : Loads the characters of the variable tableOfAllCharacters
           : into the EEPROM character memory of the max7456 circuit
 *******************************************************************************/
void loadCharSet( void )
{
  charact currentChar;
  bool initialOsdState = osdState;  // save OSD display state
  setOsdState( false );             // Deactivate osd display.
  for (int i = 0 ; i <= 0xff; i++)
  {
    Max7456::getCARACFromProgMem(tableOfAllCharacters, i, currentChar);
    osd.sendCharacter(currentChar, i);
  }
  setOsdState( initialOsdState );  // restore original OSD display state
}

/*******************************************************************************
   Function: setup
             The Arduino setup function. Automatically runs once before loop
 *******************************************************************************/
void setup()
{
  byte tab[] = {0xC8, 0xC9};
  // SPI Setup
  pinMode(CS_PIN, OUTPUT);
  pinMode(SS, OUTPUT);
  SPI.begin();

  // Serial channel setup
  Serial.begin(57600);

  // MAX7456 setup
  osd.init(CS_PIN);
  osd.setDisplayOffsets(44, 30);
  osd.setBlinkParams(_8fields, _BT_BT); // TODO - Why and What?
  setBlinkState( blinkState );
  setFillState( fillState );
  setInverseState( inverseState);
  setOsdState( osdState );
  setInVideoState(inVideoState);
  loadCharSet();
  osd.clearScreen();
}

/*******************************************************************************
   Function: loop
             Arduinos main loop function. May never return
 *******************************************************************************/
void loop()
{
  static bool activeCommand = false;
  static bool waitingForX = false;
  static bool waitingForY = false;
  static bool waitingForOffsetX = false;
  static bool waitingForOffsetY = false;
  static byte offsetX = 0;
  static byte offsetY = 0;
  long videoUpdateTimer = 0;
  unsigned char inChar;

  // Process serial data
  if (Serial.available()) {
    inChar = Serial.read();
    if ( inChar == CMD_CMD) {
      activeCommand = true;
    }
    else {
      if (activeCommand) {
        switch (inChar) {
          case CMD_LOAD_CHARS:        loadCharSet(); break;
          case CMD_CLEAR_SCREEN:      osd.clearScreen(); break;
          case CMD_ENABLE_OSD:        setOsdState( true ); break;
          case CMD_DISABLE_OSD:       setOsdState(false); break;
          case CMD_ENABLE_VIDEO:      setInVideoState( true ); break;
          case CMD_DISABLE_VIDEO:     setInVideoState( false ); break;
          case CMD_ENABLE_BLINK:      setBlinkState( true ); break;
          case CMD_DISABLE_BLINK:     setBlinkState( false ); break;
          case CMD_ENABLE_INVERSE:    setInverseState( true ); break;
          case CMD_DISABLE_INVERSE:   setInverseState( false ); break;
          case CMD_ENABLE_FILL:       setFillState( true ); break;
          case CMD_DISABLE_FILL:      setFillState( false ); break;
          case CMD_NEWLINE:           newLine(); break;
          case CMD_SET_X:             waitingForX = true; break;
          case CMD_SET_Y:             waitingForY = true; break;
          case CMD_SET_OFFSET:        waitingForOffsetX = true; break;
          default: break;           // Unknown command - Just skip it
        }
        activeCommand = false;
      }
      else if (waitingForX) {
        curX = inChar;
        waitingForX = false;
      }
      else if (waitingForY) {
        curY = inChar;
        waitingForY = false;
      }
      else if (waitingForOffsetX) {
        offsetX = inChar;
        waitingForOffsetX = false;
        waitingForOffsetY = true;
      }
      else if (waitingForOffsetY) {
        offsetY = inChar;
        waitingForOffsetY = false;
        osd.setDisplayOffsets(offsetX, offsetY);
      }
      else {
        osd.printMax7456Char( fillState && (inChar > 31) && (inChar < 128) ? inChar + 0x80 : inChar, curX++, curY, blinkState, inverseState );
        if (curX >= 30) {
          curX = 0;
          curY++;
        }
        if (curY >= MAX_LINES)
          curY = 0;
      }
    }
  }
  // Check if it is time to update the video format
  if (videoUpdateTimer < millis())
  {
    videoUpdateTimer = millis() + 500;
    updateVideoFormat();
  }
}
